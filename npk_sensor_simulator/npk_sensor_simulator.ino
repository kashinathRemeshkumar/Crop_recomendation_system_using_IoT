#define BUTTON_PIN D2

const int m = 22;  // Number of rows
const int n = 7;   // Number of columns

// Define a 2D matrix with floating-point values
float dataMatrix[m][n] = {
    {90,42,43,20.87974371,82.00274423,6.502985292,202.9355362},
    {77,58,19,22.8056033,56.50768935,5.791649933,101.5952794},
    {57,60,84,19.1034283,17.26184541,6.586777189,75.49101167},
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    {104,20,26,27.22783677,52.95261751,7.493191968,175.7260273}
};

void setup() {
    Serial.begin(9600);  // TX1 -> ESP32 RX1
    pinMode(BUTTON_PIN, INPUT_PULLUP);
}

void loop() {
    if (digitalRead(BUTTON_PIN) == LOW) {  // Button Pressed
        delay(100); // Debounce
        if (digitalRead(BUTTON_PIN) == LOW) { 
            
            int randomRow = random(0, m);  // Select a random row

            // Construct data packet
            String dataPacket = "";
            for (int j = 0; j < n; j++) {
                dataPacket += String(dataMatrix[randomRow][j], 6); // Keep 6 decimal places
                if (j < n - 1) {
                    dataPacket += ",";  // Add comma between values
                }
            }

            Serial.println(dataPacket); // Send row to ESP32
            delay(500); // Prevent multiple presses
        }
    }
}
